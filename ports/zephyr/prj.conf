## CMakeLists.txt
```
# This file is part of the MicroPython project, http://micropython.org/
#
# The MIT License (MIT)
#
# Copyright 2020 NXP
#
# Permission is hereby granted, free of charge, to any person obtaining a copy
# of this software and associated documentation files (the "Software"), to deal
# in the Software without restriction, including without limitation the rights
# to use, copy, modify, merge, publish, distribute, sublicense, and/or sell
# copies of the Software, and to permit persons to whom the Software is
# furnished to do so, subject to the following conditions:
#
# The above copyright notice and this permission notice shall be included in
# all copies or substantial portions of the Software.
#
# THE SOFTWARE IS PROVIDED "AS IS", WITHOUT WARRANTY OF ANY KIND, EXPRESS OR
# IMPLIED, INCLUDING BUT NOT LIMITED TO THE WARRANTIES OF MERCHANTABILITY,
# FITNESS FOR A PARTICULAR PURPOSE AND NONINFRINGEMENT. IN NO EVENT SHALL THE
# AUTHORS OR COPYRIGHT HOLDERS BE LIABLE FOR ANY CLAIM, DAMAGES OR OTHER
# LIABILITY, WHETHER IN AN ACTION OF CONTRACT, TORT OR OTHERWISE, ARISING FROM,
# OUT OF OR IN CONNECTION WITH THE SOFTWARE OR THE USE OR OTHER DEALINGS IN
# THE SOFTWARE.

cmake_minimum_required(VERSION 3.20.0)

find_package(Zephyr REQUIRED HINTS $ENV{ZEPHYR_BASE})
project(micropython)

set(MICROPY_PORT_DIR    ${CMAKE_CURRENT_SOURCE_DIR})
set(MICROPY_DIR         ${MICROPY_PORT_DIR}/../..)
set(MICROPY_TARGET      micropython)

include(${MICROPY_DIR}/py/py.cmake)
include(${MICROPY_DIR}/extmod/extmod.cmake)

set(MICROPY_SOURCE_PORT
    main.c
    help.c
    machine_can.c
    machine_i2c.c
    machine_led.c
    machine_spi.c
    machine_pin.c
    modbluetooth_zephyr.c
    modsocket.c
    modzephyr.c
    modzsensor.c
    mphalport.c
    uart_core.c
    zephyr_storage.c
)
list(TRANSFORM MICROPY_SOURCE_PORT PREPEND ${MICROPY_PORT_DIR}/)

set(MICROPY_SOURCE_SHARED
    libc/printf.c
    readline/readline.c
    runtime/interrupt_char.c
    runtime/mpirq.c
    runtime/pyexec.c
    runtime/stdout_helpers.c
    timeutils/timeutils.c
)
list(TRANSFORM MICROPY_SOURCE_SHARED PREPEND ${MICROPY_DIR}/shared/)

set(MICROPY_SOURCE_LIB
    oofatfs/ff.c
    oofatfs/ffunicode.c
    littlefs/lfs1.c
    littlefs/lfs1_util.c
    littlefs/lfs2.c
    littlefs/lfs2_util.c
)
list(TRANSFORM MICROPY_SOURCE_LIB PREPEND ${MICROPY_DIR}/lib/)

set(MICROPY_SOURCE_QSTR
    ${MICROPY_SOURCE_PY}
    ${MICROPY_SOURCE_EXTMOD}
    ${MICROPY_SOURCE_SHARED}
    ${MICROPY_SOURCE_LIB}
    ${MICROPY_SOURCE_PORT}
)

zephyr_get_include_directories_for_lang(C includes)
zephyr_get_system_include_directories_for_lang(C system_includes)
zephyr_get_compile_definitions_for_lang(C definitions)
zephyr_get_compile_options_for_lang(C options)

set(MICROPY_CPP_FLAGS_EXTRA ${includes} ${system_includes} ${definitions} ${options})

zephyr_library_named(${MICROPY_TARGET})

zephyr_library_include_directories(
    ${MICROPY_INC_CORE}
    ${MICROPY_PORT_DIR}
    ${CMAKE_CURRENT_BINARY_DIR}
)

zephyr_library_compile_options(
    -std=gnu99 -fomit-frame-pointer
)

zephyr_library_compile_definitions(
    NDEBUG LFS2_NO_ASSERT LFS2_NO_DEBUG
    MP_CONFIGFILE=<${CONFIG_MICROPY_CONFIGFILE}>
    MICROPY_HEAP_SIZE=${CONFIG_MICROPY_HEAP_SIZE}
    FFCONF_H=\"${MICROPY_OOFATFS_DIR}/ffconf.h\"
    MICROPY_VFS_FAT=$<BOOL:${CONFIG_MICROPY_VFS_FAT}>
    MICROPY_VFS_LFS1=$<BOOL:${CONFIG_MICROPY_VFS_LFS1}>
    MICROPY_VFS_LFS2=$<BOOL:${CONFIG_MICROPY_VFS_LFS2}>
)

zephyr_library_sources(${MICROPY_SOURCE_QSTR})
zephyr_library_link_libraries(kernel)

add_dependencies(${MICROPY_TARGET} zephyr_generated_headers)

include(${MICROPY_DIR}/py/mkrules.cmake)

target_sources(app PRIVATE
    src/zephyr_start.c
    src/zephyr_getchar.c
)

target_link_libraries(app PRIVATE ${MICROPY_TARGET})
```

## Kconfig
```
# This file is part of the MicroPython project, http://micropython.org/
#
# The MIT License (MIT)
#
# Copyright 2020 NXP
#
# Permission is hereby granted, free of charge, to any person obtaining a copy
# of this software and associated documentation files (the "Software"), to deal
# in the Software without restriction, including without limitation the rights
# to use, copy, modify, merge, publish, distribute, sublicense, and/or sell
# copies of the Software, and to permit persons to whom the Software is
# furnished to do so, subject to the following conditions:
#
# The above copyright notice and this permission notice shall be included in
# all copies or substantial portions of the Software.
#
# THE SOFTWARE IS PROVIDED "AS IS", WITHOUT WARRANTY OF ANY KIND, EXPRESS OR
# IMPLIED, INCLUDING BUT NOT LIMITED TO THE WARRANTIES OF MERCHANTABILITY,
# FITNESS FOR A PARTICULAR PURPOSE AND NONINFRINGEMENT. IN NO EVENT SHALL THE
# AUTHORS OR COPYRIGHT HOLDERS BE LIABLE FOR ANY CLAIM, DAMAGES OR OTHER
# LIABILITY, WHETHER IN AN ACTION OF CONTRACT, TORT OR OTHERWISE, ARISING FROM,
# OUT OF OR IN CONNECTION WITH THE SOFTWARE OR THE USE OR OTHER DEALINGS IN
# THE SOFTWARE.

menu "MicroPython Options"

config MICROPY_CONFIGFILE
	string "Configuration file"
	default "mpconfigport_minimal.h"

config MICROPY_HEAP_SIZE
	int "Heap size"
	default 16384

config MICROPY_VFS_FAT
	bool "FatFS file system"

config MICROPY_VFS_LFS1
	bool "LittleFs version 1 file system"

config MICROPY_VFS_LFS2
	bool "LittleFs version 2 file system"

config CANOPEN_LSS
	bool "LSS support for CANOpen"

endmenu # MicroPython Options

source "Kconfig.zephyr"
```

## prj.conf
```kconfig
CONFIG_BUILD_OUTPUT_BIN=y
CONFIG_BUILD_OUTPUT_HEX=y
CONFIG_REBOOT=y

#CONFIG_STDOUT_CONSOLE=y
#CONFIG_CONSOLE_HANDLER=y
CONFIG_UART_CONSOLE_DEBUG_SERVER_HOOKS=y

#CONFIG_CONSOLE_SUBSYS=y
#CONFIG_CONSOLE_GETCHAR=y
#CONFIG_CONSOLE_GETCHAR_BUFSIZE=128
#CONFIG_CONSOLE_PUTCHAR_BUFSIZE=128

CONFIG_NEWLIB_LIBC=y
CONFIG_FPU=y
CONFIG_FP_HARDABI=y
CONFIG_MAIN_STACK_SIZE=4736
CONFIG_POLL=y

# Enable sensor subsystem (doesn't add code if not used).
# Specific sensors should be enabled per-board.
CONFIG_SENSOR=n

# Networking config
CONFIG_NETWORKING=n
#CONFIG_NET_IPV4=y
#CONFIG_NET_IPV6=y
#CONFIG_NET_UDP=y
#CONFIG_NET_TCP=y
#CONFIG_NET_SOCKETS=y
#CONFIG_NET_SOCKETS_POSIX_NAMES=n
#CONFIG_TEST_RANDOM_GENERATOR=y

#CONFIG_NET_CONFIG_SETTINGS=y
#CONFIG_NET_CONFIG_INIT_TIMEOUT=3
#CONFIG_NET_CONFIG_NEED_IPV6=y
#CONFIG_NET_CONFIG_NEED_IPV4=y

# DNS
#CONFIG_DNS_RESOLVER=y
#CONFIG_DNS_RESOLVER_ADDITIONAL_QUERIES=2
#CONFIG_DNS_SERVER_IP_ADDRESSES=y

# Static IP addresses
#CONFIG_NET_CONFIG_MY_IPV6_ADDR="2001:db8::1"
#CONFIG_NET_CONFIG_MY_IPV4_ADDR="192.0.2.1"
#CONFIG_NET_CONFIG_MY_IPV4_GW="192.0.2.2"
#CONFIG_DNS_SERVER1="192.0.2.2"

# DHCP configuration. Until DHCP address is assigned,
# static configuration above is used instead.
#CONFIG_NET_DHCPV4=y

# Diagnostics and debugging

# Required for zephyr.stack_analyze()
CONFIG_THREAD_ANALYZER=y
CONFIG_THREAD_ANALYZER_USE_PRINTK=y
CONFIG_THREAD_NAME=y

# Required for socket.pkt_get_info()
#CONFIG_NET_BUF_POOL_USAGE=y

# Required for zephyr.shell_exec()
#CONFIG_SHELL=y
#CONFIG_SHELL_BACKEND_SERIAL_INTERRUPT_DRIVEN=n

# Required for zephyr.shell_exec("net iface")
#CONFIG_NET_SHELL=y

# Uncomment to enable "INFO" level net_buf logging
#CONFIG_NET_LOG=y
#CONFIG_NET_DEBUG_NET_BUF=y
# Change to 4 for "DEBUG" level
#CONFIG_SYS_LOG_NET_LEVEL=3

# MicroPython options
CONFIG_MICROPY_CONFIGFILE="mpconfigport.h"
CONFIG_MICROPY_VFS_FAT=y
CONFIG_MICROPY_VFS_LFS2=y
```

## boards/ln60can_nrf52840.conf
```kconfig
# console
CONFIG_CONSOLE_SUBSYS=y
CONFIG_CONSOLE_GETCHAR=y
CONFIG_CONSOLE_GETCHAR_BUFSIZE=128
CONFIG_CONSOLE_PUTCHAR_BUFSIZE=128

# networking
CONFIG_NETWORKING=n

CONFIG_BT=y
CONFIG_BT_DEVICE_NAME_DYNAMIC=y
CONFIG_BT_PERIPHERAL=y
CONFIG_BT_CENTRAL=y

# usb
#CONFIG_USB_MASS_STORAGE=y

# flash storage
CONFIG_FLASH=y
CONFIG_FLASH_MAP=y

# sdcard
CONFIG_DISK_ACCESS=y
CONFIG_DISK_DRIVERS=y
CONFIG_DISK_DRIVER_SDMMC=y
CONFIG_SDMMC_VOLUME_NAME="SDMMC"

# can
CONFIG_CAN=y
CONFIG_CAN_FD_MODE=n
CONFIG_CAN_INIT_PRIORITY=80
CONFIG_CAN_MAX_FILTER=2
CONFIG_CANOPEN_LSS=y

# micropython
CONFIG_MICROPY_HEAP_SIZE=98304
```

## boards/nrf52840dk_nrf52840.conf
```kconfig
CONFIG_CONSOLE_SUBSYS=y
CONFIG_NETWORKING=n

CONFIG_BT=y
CONFIG_BT_DEVICE_NAME_DYNAMIC=y
CONFIG_BT_PERIPHERAL=y
CONFIG_BT_CENTRAL=y

CONFIG_MICROPY_HEAP_SIZE=98304
```

## boards/nrf52840dongle_nrf52840_can.conf
```kconfig
# networking
CONFIG_NETWORKING=n

# bt
#CONFIG_BT=y
#CONFIG_BT_DEVICE_NAME_DYNAMIC=y
#CONFIG_BT_PERIPHERAL=y
#CONFIG_BT_CENTRAL=y

# flash storage
CONFIG_FLASH=y
CONFIG_FLASH_MAP=y

# console
CONFIG_CONSOLE_SUBSYS=y
CONFIG_CONSOLE_GETCHAR=y
CONFIG_CONSOLE_GETCHAR_BUFSIZE=128
CONFIG_CONSOLE_PUTCHAR_BUFSIZE=128

# micropython
CONFIG_MICROPY_HEAP_SIZE=98304
```

## boards/smpx_uart_nrf52840.conf
```kconfig
# console
CONFIG_CONSOLE_SUBSYS=y
CONFIG_CONSOLE_GETCHAR=y
CONFIG_CONSOLE_GETCHAR_BUFSIZE=128
CONFIG_CONSOLE_PUTCHAR_BUFSIZE=128

# networking
CONFIG_NETWORKING=n

CONFIG_BT=y
CONFIG_BT_DEVICE_NAME_DYNAMIC=y
CONFIG_BT_PERIPHERAL=y
CONFIG_BT_CENTRAL=y

# sdcard
CONFIG_DISK_ACCESS=y
CONFIG_DISK_DRIVERS=y
CONFIG_DISK_DRIVER_SDMMC=y
CONFIG_SDMMC_VOLUME_NAME="SDMMC"

# sdcard
CONFIG_DISK_ACCESS=y
CONFIG_DISK_DRIVERS=y
CONFIG_DISK_DRIVER_SDMMC=y

# can
CONFIG_CAN=y
CONFIG_CAN_FD_MODE=n
CONFIG_CAN_INIT_PRIORITY=80
CONFIG_CAN_MAX_FILTER=2
CONFIG_CANOPEN_LSS=y

# micropython
CONFIG_MICROPY_HEAP_SIZE=98304
```

## src/zephyr_start.c
```c
/*
 * This file is part of the MicroPython project, http://micropython.org/
 *
 * The MIT License (MIT)
 *
 * Copyright (c) 2016 Linaro Limited
 *
 * Permission is hereby granted, free of charge, to any person obtaining a copy
 * of this software and associated documentation files (the "Software"), to deal
 * in the Software without restriction, including without limitation the rights
 * to use, copy, modify, merge, publish, distribute, sublicense, and/or sell
 * copies of the Software, and to permit persons to whom the Software is
 * furnished to do so, subject to the following conditions:
 *
 * The above copyright notice and this permission notice shall be included in
 * all copies or substantial portions of the Software.
 *
 * THE SOFTWARE IS PROVIDED "AS IS", WITHOUT WARRANTY OF ANY KIND, EXPRESS OR
 * IMPLIED, INCLUDING BUT NOT LIMITED TO THE WARRANTIES OF MERCHANTABILITY,
 * FITNESS FOR A PARTICULAR PURPOSE AND NONINFRINGEMENT. IN NO EVENT SHALL THE
 * AUTHORS OR COPYRIGHT HOLDERS BE LIABLE FOR ANY CLAIM, DAMAGES OR OTHER
 * LIABILITY, WHETHER IN AN ACTION OF CONTRACT, TORT OR OTHERWISE, ARISING FROM,
 * OUT OF OR IN CONNECTION WITH THE SOFTWARE OR THE USE OR OTHER DEALINGS IN
 * THE SOFTWARE.
 */
#include <zephyr/kernel.h>
#include <zephyr/console/console.h>
#include "zephyr_getchar.h"

int real_main(void);

int main(void) {
    #ifdef CONFIG_CONSOLE_SUBSYS
    console_init();
    #else
    zephyr_getchar_init();
    #endif
    return real_main();
}
```
